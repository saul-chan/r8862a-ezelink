
/ {
	signature {

		key-dev {
			required = "conf";
			algo = "sha1,rsa2048";
			rsa,r-squared = <0xa85ac6a3 0x9b90c5f3 0xbea55e90 0x70f51ed7 0x8839b4dd 0xec694d90 0x331ebe07 0x6d59f960 0x8e9cae4a 0xe50b2e43 0x87c37460 0x711c60bb 0x243999c8 0xc128ba90 0x83f80575 0xc8256aa2 0x2a44dbc6 0x6ce3d425 0x6b2cf1df 0x9b74c3c1 0xea3af598 0x50f19328 0xab0b3ced 0xe59d15f5 0xd136f934 0xe9d5af90 0xc7cebff9 0x6b539075 0xc75b6121 0x255cafcb 0xa929dffb 0xa645fb67 0xfdf48dd5 0x1923c5c 0x61fc99ee 0x72a1396 0x64c3731 0x23e0ccc5 0x7f63c501 0x834abb5d 0xd68919a0 0xa98dd6bb 0xd8ed3246 0x19906119 0x4f88428e 0xe05e053c 0x865b194e 0xb2a2a438 0x23a40d1c 0x16e610ef 0x9a4b4b15 0xe2712104 0x31e97d77 0x7766b8ec 0xdb01773c 0x1c30f78a 0xa8f08961 0xcea5351a 0x1190510e 0x82cfba4e 0xf30e908d 0x3024597b 0xe8658406 0xca1cb49e>;
			rsa,modulus = <0xda8c4edc 0xa8564421 0x7f0e36fe 0x89d15477 0xf019e8d3 0x42574a98 0x8323ffd7 0xfc949b36 0x4d5e542d 0xd9158e3c 0xe8ac4a70 0xce441ccd 0x62952e2a 0x18819b 0xd63d97b8 0x1d426c24 0x6de4915c 0xaef3aa9e 0xb70ae0f8 0xd135eca9 0x4d61135e 0xe402cbdd 0x8f50a684 0xb393ae1e 0xaa525b0e 0xc982fcb2 0x81ecfbfa 0xbba64586 0x8d08c9d5 0x17876452 0x3b9bb611 0xcfba91a0 0xf5cbed8a 0xc0981ab 0xe19b648c 0xa62430d6 0x327aba58 0x5c13e2bf 0xa0a558ae 0xd17eeec3 0xcef81f0b 0xb7d34d4a 0x22808dfb 0x30f5e197 0xd1e3bdc9 0xe7907b95 0xc643e8d9 0x9cd91e62 0xd50f61f7 0x4e66c9 0x14f49529 0x302e3b0f 0x4e07d641 0x470d318f 0x9abbd73b 0x6fee604b 0x2b52e60c 0x60eb5429 0x8b4f6607 0x26307af1 0xdd99bf5e 0x825386a7 0x9ab67f0a 0x321f02c7>;
			rsa,exponent = <0x00 0x10001>;
			rsa,n0-inverse = <0xb0c8e109>;
			rsa,num-bits = <0x800>;
			key-name-hint = "cls-sign-fit";
		};
	};
};

