/*
 *  Copyright (c) 2021-2024, Clourney Semiconductor. All rights reserved.
 *
 *  This software and/or documentation is licensed by Clourney Semiconductor under limited terms and conditions.
 *  Reproduction and redistribution in binary or source form, with or without modification,
 *  for use solely in conjunction with a Clourney Semiconductor chipset, is permitted in condition which
 *  must retain the above copyright notice.
 *
 *  By using this software and/or documentation, you agree to the limited terms and conditions.
 *
 *  Device Tree Include file for Clourney Semiconductor SoC.
 *
 */

/dts-v1/;
/include/ "clourneysemi-dubhe2000.dtsi"

/ {
	model = "DUBHE2000 EMU Board";
	compatible = "clourneysemi,dubhe2000_emu";
	#size-cells = <0x2>;
	#address-cells = <0x2>;

	chosen {
		stdout-path = &uart0;
	};
};

&uart0 {
        status = "okay";
};

&spi0 {
	busclk = <20000000>;
	spi-max-frequency = <5000000>;
	status = "okay";
};

