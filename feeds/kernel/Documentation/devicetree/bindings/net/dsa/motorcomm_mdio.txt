## feeds/kernel/Documentation/devicetree/bindings/net/dsa/motorcomm_mdio.txt
```
Motorcomm MDIO-based Ethernet switch
================================

Required properties:

- compatible: Must be compatible = "motorcomm,yt921x";


Required properties for the child nodes within ports container:
- #address-cells: Must be 1.
- #size-cells: Must be 0.
- reg: Port address
- phy-mode: String, must be "rgmii" for port labeled "cpu".

See Documentation/devicetree/bindings/net/dsa/dsa.txt for a list of additional
required, optional properties and how the integrated switch subnodes must
be specified.

Example:

	switch {
		compatible = "motorcomm,yt921x";

		ports {
			#address-cells = <1>;
			#size-cells = <0>;

			port@0 {
				reg = <0>;
				label = "lan0";
			};
			port@1 {
				reg = <1>;
				label = "lan1";
			};
			port@2 {
				reg = <2>;
				label = "lan2";
			};
			port@3 {
				reg = <3>;
				label = "lan3";
			};
			port@4 {
				reg = <4>;
				label = "wan";
			};
			port@5 {
				reg = <8>;
				label = "cpu";
				ethernet = <&mac>;
				phy-mode = "rgmii";
				fixed-link {
					speed = <1000>;
					full-duplex;
				};
			};
		};
	};
```

## feeds/kernel/drivers/net/dsa/motorcomm/Kconfig
```kconfig
# SPDX-License-Identifier: GPL-2.0-only
config NET_DSA_MOTORCOMM
	tristate "Motorcomm Ethernet switch family support"
	depends on NET_DSA
	select FIXED_PHY
	select NET_DSA_TAG_MOTORCOMM
	help
	  This enables support for the Motorcomm mdio-based switch
	  chips currently only YT9215
config NET_DSA_VLAN_MOTORCOMM
	tristate "Motorcomm Ethernet switch family vlan tag support"
	depends on NET_DSA
	select FIXED_PHY
	select NET_DSA_VLAN_TAG_MOTORCOMM
	help
	  This enables support for the Motorcomm mdio-based switch
	  chips currently only YT9215 series and YT9218 series
```

## feeds/kernel/drivers/pinctrl/clourney/Kconfig
```kconfig
config PINCTRL_CLOURNEY
	bool "Clourney dubhe pinctrl driver"
	depends on (ARM || ARM64)
	default y
	select GENERIC_PINCTRL_GROUPS
	select GENERIC_PINMUX_FUNCTIONS
	select GENERIC_PINCONF
	select REGMAP
	help
	  Say Y here to enable the clourney dubhe pinctrl driver
```

## feeds/kernel/sound/soc/dwc/Kconfig
```kconfig
# SPDX-License-Identifier: GPL-2.0-only
config SND_DESIGNWARE_I2S
	tristate "Synopsys I2S Device Driver"
	depends on CLKDEV_LOOKUP
	select SND_SOC_GENERIC_DMAENGINE_PCM
	help
	 Say Y or M if you want to add support for I2S driver for
	 Synopsys designware I2S device. The device supports up to
	 a maximum of 8 channels each for play and record.

config SND_DESIGNWARE_TDM
        bool "TDM extension for I2S driver"
        depends on SND_DESIGNWARE_I2S
        help
         Say Y or N if you want to add a custom ALSA extension that registers
         a TDM and uses PIO or interal DMA to transfer data.

         This functionality is specially suited for I2S devices that don't have
         External DMA support.

config SND_DESIGNWARE_PCM
	bool "PCM PIO extension for I2S driver"
	depends on SND_DESIGNWARE_I2S
	help
	 Say Y or N if you want to add a custom ALSA extension that registers
	 a PCM and uses PIO to transfer data.

	 This functionality is specially suited for I2S devices that don't have
	 DMA support.

config I2S_DMA_REPLACE_FIFO
	bool "I2S DMA is enabled, replace LTHRx and RTHRx"
	depends on SND_DESIGNWARE_I2S
	help
	 Say Y or N when data to be transmitted/receivered by TX/RX
	 channels are written/readed to the TX/RX FIFOs through the
	 TXDMA/RXDMA register rather than through LTHRx and RTHRx.

config TDM_DMA_REPLACE_FIFO
        bool "TDM DMA is enabled, replace TSLOTx and RSLOTx"
        depends on SND_DESIGNWARE_I2S
        help
	 Say Y or N when data to be transmitted/receivered by TX/RX
	 channels are written/readed to the TX/RX FIFOs through the
	 TXDMA/RXDMA register rather than through TSLOTx and RSLOTx.
```

## package/boot/uboot-clsemi/dummy.its
```
/dts-v1/;

/ {
	description = "dummy fit";
	#address-cells = <1>;

	images {
		kernel {
			description = "dummy kernel";
			data = /incbin/("/dev/null");
			type = "kernel";
			arch = "arm64";
			os = "linux";
			compression = "lzma";
			load = <0x10000000>;
			entry = <0x10000000>;
			hash-1 {
				algo = "crc32";
			};
			hash-2 {
				algo = "sha1";
			};
		};
		fdt-1 {
			description = "dummy dtb";
			data = /incbin/("/dev/null");
			type = "flat_dt";
			arch = "arm64";
			compression = "none";
			hash-1 {
				algo = "crc32";
			};
			hash-2 {
				algo = "sha1";
			};
		};
	};

	configurations {
		default = "conf-1";
		conf-1 {
			description = "dummy conf";
			kernel = "kernel";
			fdt = "fdt-1";
			signature {
				algo = "sha1,rsa2048";
				key-name-hint = "${key_name}";
			};
		};
	};
};
```

## package/boot/uboot-clsemi/src/board/clourneysemi/dubhe2000_rdb/Kconfig
```kconfig
if TARGET_DUBHE2000_RDB

config CLOURNEY_SEMI
        bool "ClourneySemi WIFI AP CPUs Variants"

config SYS_BOARD
	default "dubhe2000_rdb"

config SYS_VENDOR
	default "clourneysemi"

config SYS_SOC
	default "dubhe2000"

config SYS_CONFIG_NAME
	default "dubhe2000_rdb"

config BRD_BOOT_FLASH_VARIANT
	depends on MTD
        int "board boot from flash variant"
        default 1
        help
          This defines board bootup flash variant.
	  BRD_BOOT_FROM_PNAND    1
	  BRD_BOOT_FROM_SPINAND  2
	  BRD_BOOT_FROM_SPINOR   3

config BRD_PLAT_RUN_CLK_VARIANT
	int "board platform running clock variant"
	default 1
	help
	  This defines board platform running clock variant.
	  BRD_PLAT_RUN_EMU_CLK    1
	  BRD_PLAT_RUN_FPGA_CLK   2
	  BRD_PLAT_RUN_SOC_CLK    3

config BOARD_SDRAM_SIZE
        hex
        default 0x40000000

endif
```

## package/boot/uboot-clsemi/src/board/clourneysemi/dubhe2000_rdk_t/Kconfig
```kconfig
if TARGET_DUBHE2000_RDK_T

config CLOURNEY_SEMI
        bool "ClourneySemi WIFI AP CPUs Variants"

config SYS_BOARD
	default "dubhe2000_rdk_t"

config SYS_VENDOR
	default "clourneysemi"

config SYS_SOC
	default "dubhe2000"

config SYS_CONFIG_NAME
	default "dubhe2000_rdk_t"

config BRD_BOOT_FLASH_VARIANT
	depends on MTD
        int "board boot from flash variant"
        default 2
        help
          This defines board bootup flash variant.
	  BRD_BOOT_FROM_PNAND    1
	  BRD_BOOT_FROM_SPINAND  2
	  BRD_BOOT_FROM_SPINOR   3

config BRD_PLAT_RUN_CLK_VARIANT
	int "board platform running clock variant"
	default 3
	help
	  This defines board platform running clock variant.
	  BRD_PLAT_RUN_EMU_CLK    1
	  BRD_PLAT_RUN_FPGA_CLK   2
	  BRD_PLAT_RUN_SOC_CLK    3

config BOARD_SDRAM_SIZE
        hex
        default 0x20000000

config COUNTER_FREQUENCY
        int "Timer clock frequency"
        default 48000000
        help
          Setup time clock frequency

endif
```

## package/boot/uboot-clsemi/src/cmd/clourney/Kconfig
```kconfig
menu "Clourney specific command line interface"

config CMD_CLS_BIMID
        bool "command for get clourney bootloader image id"
        help
           This command supports check image valid and get image id.

endmenu
```

## package/boot/uboot-clsemi/src/configs/dubhe2000_emu_pnand_buildroot_defconfig
```kconfig
CONFIG_ARM=y
CONFIG_TARGET_DUBHE2000_EMU=y
CONFIG_SYS_TEXT_BASE=0x00080000
CONFIG_SYS_MALLOC_LEN=0x120000
CONFIG_NR_DRAM_BANKS=1
CONFIG_ENV_OFFSET=0x180000
CONFIG_ENV_SIZE=0x20000
CONFIG_ENV_IS_IN_NAND=y
CONFIG_NAND_BOOT=y
CONFIG_SYS_LOAD_ADDR=0x00200000
CONFIG_DEFAULT_DEVICE_TREE="clourneysemi-dubhe2000-emu-pnand"
CONFIG_BOOTDELAY=1
CONFIG_OF_CONTROL=y
CONFIG_OF_EMBED=y
CONFIG_DM=y
CONFIG_DM_SERIAL=y
# CONFIG_PL01X_SERIAL is not set
CONFIG_SYS_NS16550=y
CONFIG_BAUDRATE=1152
CONFIG_ETH=y
CONFIG_PHY_FIXED=y
CONFIG_DM_ETH=y
CONFIG_CLOURNEY_ETH=y
# CONFIG_CLOURNEY_ETH_DBG is not set
CONFIG_CLS_NPE=y
CONFIG_CMD_PING=y
# CONFIG_MMC is not set
# CONFIG_DISPLAY_CPUINFO is not set
# CONFIG_ARCH_FIXUP_FDT_MEMORY is not set
CONFIG_USE_BOOTARGS=y
CONFIG_BOOTARGS="console=ttyS0,1152 earlycon=uart8250,mmio32,0x90008000 rdinit=/linuxrc rw rootwait"
CONFIG_FIT=y
CONFIG_GZIP=y
CONFIG_CMD_MEMTEST=y
CONFIG_SYS_ALT_MEMTEST=y
CONFIG_CLOURNEY_SEMI=y
CONFIG_BRD_BOOT_FLASH_VARIANT=1
CONFIG_BRD_PLAT_RUN_CLK_VARIANT=1
CONFIG_MTD=y
CONFIG_MTD_RAW_NAND=y
CONFIG_NAND_DUBHE1000=y
CONFIG_SYS_NAND_ONFI_DETECTION=y
```

## package/boot/uboot-clsemi/src/configs/dubhe2000_evb-n_defconfig
```kconfig
CONFIG_ARM=y
CONFIG_TARGET_DUBHE2000_EVB_N=y
CONFIG_SYS_TEXT_BASE=0x00080000
CONFIG_SYS_MALLOC_LEN=0x120000
CONFIG_NR_DRAM_BANKS=1
CONFIG_SYS_REDUNDAND_ENVIRONMENT=y
CONFIG_ENV_OFFSET=0x380000
CONFIG_ENV_OFFSET_REDUND=0x3A0000
CONFIG_ENV_SIZE=0x20000
CONFIG_ENV_SECT_SIZE=0x1000
CONFIG_ENV_IS_IN_SPI_FLASH=y
CONFIG_SYSINFO_SUPPORT=y
CONFIG_SYSINFO_OFFSET=0x3C0000
CONFIG_SYSINFO_OFFSET_REDUND=0x3E0000
CONFIG_SYSINFO_SIZE=0x20000
CONFIG_SYSINFO_SECT_SIZE=0x1000
CONFIG_SYSINFO_IS_IN_SPI_FLASH=y
# CONFIG_SYSINFO_IS_IN_MTD is not set
CONFIG_CMD_SAVESYSINFO=y
CONFIG_SYS_LOAD_ADDR=0x00400000
CONFIG_DEFAULT_DEVICE_TREE="clourneysemi-dubhe2000-evb-n"
CONFIG_COUNTER_FREQUENCY=40000000
CONFIG_BOOTDELAY=3
CONFIG_OF_CONTROL=y
CONFIG_OF_EMBED=y
CONFIG_DM=y
CONFIG_DM_SERIAL=y
# CONFIG_PL01X_SERIAL is not set
CONFIG_SYS_NS16550=y
CONFIG_BAUDRATE=115200
CONFIG_ETH=y
CONFIG_DM_ETH=y
CONFIG_NETDEVICES=y
CONFIG_RGMII=y
CONFIG_MII=y
CONFIG_PHYLIB=y
CONFIG_PROT_UDP=y
CONFIG_CMD_MDIO=y
CONFIG_CMD_LOG=y
CONFIG_PHY_MARVELL=y
CONFIG_PHY_REALTEK=y
CONFIG_PHY_FIXED=y
CONFIG_CLK=y
CONFIG_CLK_CCF=y
CONFIG_CLOURNEY_ETH=y
CONFIG_CLS_PHYLINK=y
CONFIG_CLOURNEY_ETH_DBG=y
CONFIG_CLS_NPE=y
CONFIG_CLS_RTKSDK=y
CONFIG_CMD_PING=y
CONFIG_MMC=y
CONFIG_MMC_SDHCI=y
CONFIG_MMC_SDHCI_SDMA=y
CONFIG_MMC_SDHCI_CLS=y
CONFIG_SUPPORT_EMMC_BOOT=y
CONFIG_SUPPORT_EMMC_RPMB=y
CONFIG_FS_LOADER=y
CONFIG_CMD_EXT4=y
CONFIG_CMD_FAT=y
CONFIG_CMD_MMC=y
CONFIG_CMD_SQUASHFS=y
CONFIG_EFI_PARTITION=y
CONFIG_PARTITION_TYPE_GUID=y
CONFIG_CMD_GPT=y
CONFIG_CMD_GPT_RENAME=y
CONFIG_CMD_PART=y
CONFIG_RANDOM_UUID=y
# CONFIG_DISPLAY_CPUINFO is not set
# CONFIG_ARCH_FIXUP_FDT_MEMORY is not set
CONFIG_USE_BOOTARGS=y
CONFIG_BOOTARGS="ubi.mtd=fw1 rootfstype=squashfs rootwait ro"
CONFIG_FIT=y
CONFIG_GZIP=y
CONFIG_CMD_CACHE=y
CONFIG_CMD_CACHE_FLUSH=y
# CONFIG_CMD_ELF is not set
# CONFIG_CMD_FLASH is not set
# CONFIG_CMD_LOADS is not set
CONFIG_CMD_CLS_BIMID=y
CONFIG_CMD_MEMTEST=y
CONFIG_SYS_ALT_MEMTEST=y
CONFIG_CLOURNEY_SEMI=y
CONFIG_BRD_BOOT_FLASH_VARIANT=3
CONFIG_BRD_PLAT_RUN_CLK_VARIANT=3
CONFIG_CMD_MTD=y
# CONFIG_CMD_NAND is not set
CONFIG_MTD=y
# CONFIG_MTD_RAW_NAND is not set
# CONFIG_MTD_SPI_NAND is not set
CONFIG_CMD_MTDPARTS=y
# CONFIG_MTD_NOR_FLASH is not set
CONFIG_MTDIDS_DEFAULT="nor1=nor1"
CONFIG_MTDPARTS_DEFAULT="mtdparts=nor1:256k(sbl),256k(atf),512k(platformdata),1536k(uboot),512k(caldata),512k(caldata2),128k(ubootenv),128k(ubootenv2),128k(boarddata),128k(boarddata2),24M(fw1),4M(reserved)"
CONFIG_CMD_SPI=y
CONFIG_DM_SPI_FLASH=y
CONFIG_CLS_SPI_FLASH=y
CONFIG_SPI_FLASH_MTD=y
CONFIG_SPI_FLASH_STMICRO=y
CONFIG_SPI_FLASH_WINBOND=y
CONFIG_SPI_FLASH_GIGADEVICE=y
CONFIG_SPI_FLASH_ZETTA=y
CONFIG_SPI_FLASH_MACRONIX=y
CONFIG_SPI_FLASH_ISSI=y
CONFIG_SPI=y
CONFIG_DM_SPI=y
CONFIG_DESIGNWARE_SPI=y
# CONFIG_SPI_FLASH_USE_4K_SECTORS is not set
CONFIG_HW_WATCHDOG=y
CONFIG_CLS_WATCHDOG=y
CONFIG_HUSH_PARSER=y
CONFIG_BOOTARGS_SUBST=y
CONFIG_USE_DEFAULT_ENV_FILE=y
CONFIG_DEFAULT_ENV_FILE="./cls-nor-env.txt"
```

## package/boot/uboot-clsemi/src/configs/dubhe2000_fpga_pnand_buildroot_defconfig
```kconfig
CONFIG_ARM=y
CONFIG_TARGET_DUBHE2000_FPGA=y
CONFIG_SYS_TEXT_BASE=0x00080000
CONFIG_SYS_MALLOC_LEN=0x120000
CONFIG_NR_DRAM_BANKS=1
CONFIG_ENV_OFFSET=0x180000
CONFIG_ENV_SIZE=0x20000
CONFIG_ENV_IS_IN_NAND=y
CONFIG_NAND_BOOT=y
CONFIG_SYS_LOAD_ADDR=0x00200000
CONFIG_DEFAULT_DEVICE_TREE="clourneysemi-dubhe2000-fpga-pnand"
CONFIG_BOOTDELAY=1
CONFIG_OF_CONTROL=y
CONFIG_OF_EMBED=y
CONFIG_DM=y
CONFIG_DM_SERIAL=y
# CONFIG_PL01X_SERIAL is not set
CONFIG_SYS_NS16550=y
CONFIG_BAUDRATE=9600
CONFIG_ETH=y
CONFIG_DM_ETH=y
CONFIG_NETDEVICES=y
CONFIG_RGMII=y
CONFIG_MII=y
CONFIG_PHYLIB=y
CONFIG_PROT_UDP=y
CONFIG_CMD_MDIO=y
CONFIG_CMD_LOG=y
CONFIG_PHY_MARVELL=y
CONFIG_PHY_REALTEK=y
CONFIG_PHY_FIXED=y
CONFIG_CLOURNEY_ETH=y
CONFIG_CLS_PHYLINK=y
CONFIG_CLOURNEY_ETH_DBG=y
CONFIG_CLS_NPE=y
CONFIG_CMD_PING=y
# CONFIG_MMC is not set
# CONFIG_DISPLAY_CPUINFO is not set
# CONFIG_ARCH_FIXUP_FDT_MEMORY is not set
CONFIG_USE_BOOTARGS=y
CONFIG_BOOTARGS="console=ttyS0,9600 earlycon=uart8250,mmio32,0x90008000 rdinit=/linuxrc rw rootwait"
CONFIG_FIT=y
CONFIG_GZIP=y
CONFIG_CMD_CACHE=y
CONFIG_CMD_CACHE_FLUSH=y
# CONFIG_CMD_ELF is not set
# CONFIG_CMD_FLASH is not set
# CONFIG_CMD_LOADS is not set
CONFIG_CMD_MEMTEST=y
CONFIG_SYS_ALT_MEMTEST=y
CONFIG_CLOURNEY_SEMI=y
CONFIG_BRD_BOOT_FLASH_VARIANT=1
CONFIG_BRD_PLAT_RUN_CLK_VARIANT=2
CONFIG_CMD_MTD=y
CONFIG_CMD_NAND=y
CONFIG_MTD=y
CONFIG_MTD_RAW_NAND=y
CONFIG_CMD_MTDPARTS=y
CONFIG_NAND_DUBHE1000=y
CONFIG_SYS_NAND_ONFI_DETECTION=y
CONFIG_MTDIDS_DEFAULT="nand0=nand0"
CONFIG_MTDPARTS_DEFAULT="mtdparts=nand0:128k(sbl),384k(atf),1024k(u-boot),512k(u-boot-env),30M(kernel),88M(rootfs),8M(ubifs)"
```

## package/boot/uboot-clsemi/src/configs/dubhe2000_rdk-c_defconfig
```kconfig
CONFIG_ARM=y
CONFIG_TARGET_DUBHE2000_RDK_C=y
CONFIG_SYS_TEXT_BASE=0x00080000
CONFIG_SYS_MALLOC_LEN=0x120000
CONFIG_NR_DRAM_BANKS=1
CONFIG_CMD_UBI=y
CONFIG_CMD_UBI_RENAME=y
CONFIG_CMD_UBIFS=y
CONFIG_ENV_SIZE=0x1f000
CONFIG_ENV_IS_IN_UBI=y
CONFIG_SYS_REDUNDAND_ENVIRONMENT=y
CONFIG_ENV_UBI_PART="ubootenv"
CONFIG_ENV_UBI_VOLUME="ubootenv"
CONFIG_ENV_UBI_VOLUME_REDUND="ubootenv2"
CONFIG_ENV_UBI_VOLUME_CREATE=y
CONFIG_ENV_UBI_VID_OFFSET=0
CONFIG_SYSINFO_SUPPORT=y
CONFIG_SYSINFO_IS_IN_UBI=y
CONFIG_SYSINFO_UBI_PART="boarddata"
CONFIG_SYSINFO_UBI_VOLUME="boarddata"
CONFIG_SYSINFO_UBI_VOLUME_REDUND="boarddata2"
CONFIG_SYSINFO_UBI_VOLUME_CREATE=y
CONFIG_SYSINFO_UBI_VID_OFFSET=0
# CONFIG_SYSINFO_IS_IN_MTD is not set
CONFIG_SYSINFO_SIZE=0x1f000
CONFIG_CMD_SAVESYSINFO=y
CONFIG_SYS_LOAD_ADDR=0x00200000
CONFIG_DEFAULT_DEVICE_TREE="clourneysemi-dubhe2000-rdk-c"
CONFIG_COUNTER_FREQUENCY=40000000
CONFIG_BOOTDELAY=3
CONFIG_OF_CONTROL=y
CONFIG_OF_EMBED=y
CONFIG_DM=y
CONFIG_DM_SERIAL=y
# CONFIG_PL01X_SERIAL is not set
CONFIG_SYS_NS16550=y
CONFIG_BAUDRATE=115200
CONFIG_ETH=y
CONFIG_DM_ETH=y
CONFIG_NETDEVICES=y
CONFIG_RGMII=y
CONFIG_MII=y
CONFIG_PHYLIB=y
CONFIG_PROT_UDP=y
CONFIG_CMD_MDIO=y
CONFIG_CMD_LOG=y
CONFIG_PHY_MARVELL=y
CONFIG_PHY_REALTEK=y
CONFIG_PHY_FIXED=y
CONFIG_CLOURNEY_ETH=y
CONFIG_CLS_PHYLINK=y
CONFIG_CLOURNEY_ETH_DBG=y
CONFIG_CLS_NPE=y
CONFIG_CMD_PING=y

# CONFIG_MMC is not set
# CONFIG_DISPLAY_CPUINFO is not set
# CONFIG_ARCH_FIXUP_FDT_MEMORY is not set
CONFIG_USE_BOOTARGS=y
CONFIG_BOOTARGS="ubi.mtd=fw1 rootfstype=squashfs rootwait ro"
CONFIG_FIT=y
CONFIG_GZIP=y
CONFIG_CMD_CACHE=y
CONFIG_CMD_CACHE_FLUSH=y
# CONFIG_CMD_ELF is not set
# CONFIG_CMD_FLASH is not set
# CONFIG_CMD_LOADS is not set
CONFIG_CMD_CLS_BIMID=y
CONFIG_CMD_MEMTEST=y
CONFIG_SYS_ALT_MEMTEST=y
CONFIG_CLOURNEY_SEMI=y
CONFIG_BRD_BOOT_FLASH_VARIANT=2
CONFIG_BRD_PLAT_RUN_CLK_VARIANT=3
CONFIG_CMD_MTD=y
# CONFIG_CMD_NAND is not set
CONFIG_MTD=y
CONFIG_MTD_RAW_NAND=y
CONFIG_MTD_SPI_NAND=y
CONFIG_CMD_MTDPARTS=y
CONFIG_NAND_DUBHE1000=y
CONFIG_SYS_NAND_ONFI_DETECTION=y
CONFIG_MTD_UBI=y
CONFIG_MTD_UBI_WL_THRESHOLD=4096
CONFIG_MTD_UBI_BEB_LIMIT=2
CONFIG_MTDIDS_DEFAULT="spi-nand0=spi-nand0"
CONFIG_MTDPARTS_DEFAULT="mtdparts=spi-nand0:512k(sbl),512k(atf),1024k(platformdata),2048k(uboot),1024k(caldata),1024k(caldata2),1536k(ubootenv),1536k(boarddata),32M(fw1),32M(fw2),55M(reserved)"
CONFIG_CMD_SPI=y
CONFIG_DM_SPI_FLASH=y
CONFIG_CLS_SPI_FLASH=y
CONFIG_SPI_FLASH_MTD=y
CONFIG_SPI_FLASH_STMICRO=y
CONFIG_SPI_FLASH_WINBOND=y
CONFIG_SPI=y
CONFIG_DM_SPI=y
CONFIG_DESIGNWARE_SPI=y
# CONFIG_SPI_FLASH_USE_4K_SECTORS is not set
CONFIG_HW_WATCHDOG=y
CONFIG_CLS_WATCHDOG=y
CONFIG_HUSH_PARSER=y
CONFIG_BOOTARGS_SUBST=y
CONFIG_USE_DEFAULT_ENV_FILE=y
CONFIG_DEFAULT_ENV_FILE="./cls-default-env.txt"
```
