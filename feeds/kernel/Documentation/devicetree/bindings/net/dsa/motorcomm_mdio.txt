## package/boot/uboot-clsemi/src/configs/dubhe2000_soc_pnand_buildroot_defconfig
```kconfig
CONFIG_ARM=y
CONFIG_TARGET_DUBHE2000_RDB=y
CONFIG_SYS_TEXT_BASE=0x00080000
CONFIG_SYS_MALLOC_LEN=0x120000
CONFIG_NR_DRAM_BANKS=1
CONFIG_ENV_OFFSET=0x180000
CONFIG_ENV_SIZE=0x20000
CONFIG_ENV_IS_IN_NAND=y
CONFIG_NAND_BOOT=y
CONFIG_SYS_LOAD_ADDR=0x00200000
CONFIG_DEFAULT_DEVICE_TREE="clourneysemi-dubhe2000-rdb-pnand"
CONFIG_BOOTDELAY=1
CONFIG_OF_CONTROL=y
CONFIG_OF_EMBED=y
CONFIG_DM=y
CONFIG_DM_SERIAL=y
# CONFIG_PL01X_SERIAL is not set
CONFIG_SYS_NS16550=y
CONFIG_BAUDRATE=9600
# CONFIG_MMC is not set
# CONFIG_DISPLAY_CPUINFO is not set
# CONFIG_ARCH_FIXUP_FDT_MEMORY is not set
CONFIG_USE_BOOTARGS=y
CONFIG_BOOTARGS="console=ttyS0,9600 earlycon=uart8250,mmio32,0x90008000 rdinit=/linuxrc rw rootwait"
CONFIG_FIT=y
CONFIG_GZIP=y
CONFIG_CMD_CACHE=y
CONFIG_CMD_CACHE_FLUSH=y
# CONFIG_CMD_ELF is not set
# CONFIG_CMD_FLASH is not set
# CONFIG_CMD_LOADS is not set
CONFIG_CMD_MEMTEST=y
CONFIG_SYS_ALT_MEMTEST=y
CONFIG_CLOURNEY_SEMI=y
CONFIG_BRD_BOOT_FLASH_VARIANT=1
CONFIG_BRD_PLAT_RUN_CLK_VARIANT=3
CONFIG_CMD_MTD=y
CONFIG_CMD_NAND=y
CONFIG_MTD=y
CONFIG_MTD_RAW_NAND=y
CONFIG_CMD_MTDPARTS=y
CONFIG_NAND_DUBHE1000=y
CONFIG_SYS_NAND_ONFI_DETECTION=y
CONFIG_MTDIDS_DEFAULT="nand0=nand0"
CONFIG_MTDPARTS_DEFAULT="mtdparts=nand0:128k(sbl),384k(atf),1024k(u-boot),512k(u-boot-env),30M(kernel),88M(rootfs),8M(ubifs)"
```

## package/boot/uboot-clsemi/src/drivers/net/clourney/Kconfig
```kconfig
#
# Clourneysemi network device configuration
#

config CLOURNEY_ETH
	bool "Clourneysemi devices"
	default y
	help
	  If you have a network (Ethernet) card belonging to this class, say Y.

	  Note that the answer to this question doesn't directly affect the
	  kernel: saying N will just cause the configurator to skip all
	  the questions about Intel cards. If you say Y, you will be asked for
	  your specific card in the following questions.

if CLOURNEY_ETH

config CLS_PHYLINK
	bool "PHY function"
	help
		Contains phy setting, mdio.

config CLS_RTKSDK
	bool "realtek phy sdk"
	depends on CLS_PHYLINK
	help
		Contains realtek (rtl8214fc/rtl8261BE/rtl8221B) phys setting.

config CLOURNEY_ETH_DBG
	bool "debug the clourney's ethernet"
	help
		print the cls_edma log.

config CLS_YTSWITCH
	bool "yt switch support"
	depends on CLS_PHYLINK
	help
		yt switch (yt9215s) support

config CLS_NPE
	tristate "Clourneysemi Dubhe1000 support"
        help
	  This driver supports Clourneysemi adapters.  

endif # CLOURNEY_ETH
```

## target/linux/clsemi/image/Config.in
```kconfig
config EXTRA_IMAGE_NAME
	string "Extra image name"
	depends on TARGET_clsemi
	default ""

config EXTRA_VERSION_NUMBER
	string "Extra version number"
	depends on TARGET_clsemi
	default ""
```
